## esp/tft_touch_s3/main/Kconfig.projbuild
```kconfig
menu "TFT Touch S3 Example Configuration"

    config EXAMPLE_LCD_PIXEL_CLOCK_HZ
        int "LCD SPI pixel clock (Hz)"
        default 20000000
        help
            SPI clock frequency for ST7789. 20 MHz is safe for most modules.

    config EXAMPLE_PIN_NUM_SCLK
        int "SPI SCLK GPIO"
        default 18

    config EXAMPLE_PIN_NUM_MOSI
        int "SPI MOSI GPIO"
        default 17

    config EXAMPLE_PIN_NUM_MISO
        int "SPI MISO GPIO"
        default 21
        help
            Required by XPT2046 to return touch coordinates.

    config EXAMPLE_PIN_NUM_LCD_DC
        int "LCD DC GPIO"
        default 5

    config EXAMPLE_PIN_NUM_LCD_RST
        int "LCD RST GPIO"
        default 3

    config EXAMPLE_PIN_NUM_LCD_CS
        int "LCD CS GPIO"
        default 4

    config EXAMPLE_PIN_NUM_BK_LIGHT
        int "LCD Backlight GPIO"
        default 2
        help
            Backlight control pin connected to the TFT module LED pin.

    config EXAMPLE_BK_LIGHT_ON_LEVEL
        int "LCD backlight on level"
        range 0 1
        default 1
        help
            GPIO level that turns the TFT backlight on. Most 2.4-inch SPI TFT modules use active-high LED backlight.
            Set this to 0 if your module uses active-low backlight.

    config EXAMPLE_PIN_NUM_TOUCH_CS
        int "Touch CS GPIO"
        default 15

    config EXAMPLE_TOUCH_SWAP_XY
        bool "Swap touch X/Y coordinates"
        default n

    config EXAMPLE_TOUCH_MIRROR_X
        bool "Mirror touch X coordinate"
        default y

    config EXAMPLE_TOUCH_MIRROR_Y
        bool "Mirror touch Y coordinate"
        default n

    config EXAMPLE_TOUCH_LOG
        bool "Log touch coordinates"
        default n
        help
            Print touch coordinates to the serial monitor. Enable this only while calibrating touch input.

    config EXAMPLE_PROV_SERVICE_NAME
        string "BLE provisioning service name prefix"
        default "edge-ai-lab"
        help
            BLE device name prefix used during WiFi provisioning. The last 3 bytes of the STA MAC are appended.

    config EXAMPLE_PROV_POP
        string "BLE provisioning proof-of-possession"
        default "abcd1234"
        help
            Proof-of-possession used by the Espressif provisioning app for the security 1 handshake.

    config EXAMPLE_WIFI_MAX_RETRY
        int "WiFi connection retry count"
        range 1 20
        default 5
        help
            Number of WiFi reconnect attempts before the UI reports a connection failure.

endmenu

menu "Assistant Hardware"

    config ASSISTANT_BTN_GPIO
        int "Wake button GPIO"
        default 38
        help
            Single-click triggers voice assistant. WARNING: GPIO0 is the ESP32-S3
            boot-mode strapping pin — do NOT use it.

    config ASSISTANT_LED_GPIO
        int "RGB LED (WS2812) GPIO"
        default 48

    config ASSISTANT_MIC_BCLK
        int "Microphone I2S BCLK GPIO"
        default 35

    config ASSISTANT_MIC_WS
        int "Microphone I2S WS GPIO"
        default 36

    config ASSISTANT_MIC_DIN
        int "Microphone I2S DIN GPIO"
        default 37

    config ASSISTANT_SPK_BCLK
        int "Speaker I2S BCLK GPIO"
        default 39

    config ASSISTANT_SPK_LRCLK
        int "Speaker I2S LRCLK GPIO"
        default 40

    config ASSISTANT_SPK_DOUT
        int "Speaker I2S DOUT GPIO"
        default 41

    config ASSISTANT_SPK_SD_MODE
        int "Speaker SD_MODE (mute) GPIO"
        default 42

    config ASSISTANT_WS_URL
        string "xiaozhi WebSocket URL"
        default "wss://api.xiaozhi.me/xiaozhi/v1/"

    config ASSISTANT_WS_TOKEN
        string "xiaozhi API token"
        default ""
        help
            Token from xiaozhi.me device console. Leave empty during development.

endmenu
```

## sources/meta-cis/meta-dev2-cis/conf/layer.conf
```bitbake
# We have a conf and classes directory, add to BBPATH
BBPATH .= ":${LAYERDIR}"

# We have recipes-* directories, add to BBFILES
BBFILES += "${LAYERDIR}/recipes-*/*/*.bb \
	${LAYERDIR}/recipes-*/*/*.bbappend"

BBFILE_COLLECTIONS += "meta-cis"
BBFILE_PATTERN_meta-cis = "^${LAYERDIR}/"
BBFILE_PRIORITY_meta-cis = "8"
LAYERSERIES_COMPAT_meta-cis = "langdale"
LICENSE_PATH += "${LAYERDIR}/licenses"
require cis_extra.conf
```
